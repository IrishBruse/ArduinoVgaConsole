/*
*/
#ifndef ARDUINO
#define PROGMEM
#define pgm_read_byte(addr) (*(addr))
#define pgm_read_word(addr) (*(addr))
#define byte unsigned char
#else
#include <VGAX.h>
#endif
#include <stdlib.h>

#define IMG_PLAYER_MASK_WIDTH 8
#define IMG_PLAYER_MASK_BWIDTH 2
#define IMG_PLAYER_MASK_HEIGHT 8
#define IMG_PLAYER_MASK_SPRITES_CNT 8
//data size=64 bytes
const unsigned char img_player_mask_data[IMG_PLAYER_MASK_SPRITES_CNT][IMG_PLAYER_MASK_HEIGHT*IMG_PLAYER_MASK_BWIDTH] PROGMEM={
{ 255, 255,    255, 255,    240, 63,    240, 63,    192, 15,    192, 15,    240, 63,    243,  63, },
{ 255, 255,    255, 255,    240, 63,    240, 63,    192, 15,    240, 63,    240, 63,    207,  63, },
{ 255, 255,    255, 255,    240, 63,    240, 63,    192, 15,     48, 51,    240, 63,    240, 255, },
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{ 255, 255,    255, 255,    252, 15,    252, 15,    192,  0,    252, 15,    252, 15,    255,  51, }
};
//image generated from 2BITIMAGE - by Sandro Maffiodo
#define IMG_PLAYER_WIDTH 8
#define IMG_PLAYER_BWIDTH 2
#define IMG_PLAYER_HEIGHT 8
#define IMG_PLAYER_SPRITES_CNT 8
//data size=128 bytes
const unsigned char img_player_data[IMG_PLAYER_SPRITES_CNT][IMG_PLAYER_HEIGHT*IMG_PLAYER_BWIDTH] PROGMEM={
{ 0,0,    0,0,    0,0,    3, 192,     32, 32,     48, 48,    10, 128,    0, 0, },
{ 0,0,    0,0,    0,0,    3, 192,     32, 32,     12,  0,    10, 128,    0, 0, },
{ 0,0,    0,0,    0,0,    3, 192,     32, 32,    192, 12,    10, 128,    0, 0, },
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{ 0,0,    0,0,    0,0,    3, 192,     56, 11,      0,  0,     2, 160,    0, 0, }
};

//image generated from 2BITIMAGE - by Sandro Maffiodo
#define IMG_ENEMY0_MASK_WIDTH 8
#define IMG_ENEMY0_MASK_BWIDTH 2
#define IMG_ENEMY0_MASK_HEIGHT 8
#define IMG_ENEMY0_MASK_SPRITES_CNT 4
//data size=64 bytes
const unsigned char img_enemy0_mask_data[IMG_ENEMY0_MASK_SPRITES_CNT][IMG_ENEMY0_MASK_HEIGHT*IMG_ENEMY0_MASK_BWIDTH] PROGMEM={
{ 255, 255,    255, 255,    255, 255,    255, 255,    240, 15,    240, 15,    240, 15,    243, 207 },
{ 255, 255,    255, 255,    255, 255,    255, 255,    240, 15,    240, 15,    240, 15,    252, 243 },
{ 255, 255,    255, 255,    255, 255,    255, 255,    240, 15,    240, 15,    240, 15,    243, 207 },
{ 255, 255,    255, 255,    255, 255,    255, 255,    240, 15,    240, 15,    240, 15,    207,  63 }
};

//image generated from 2BITIMAGE - by Sandro Maffiodo
#define IMG_ENEMY0_WIDTH 8
#define IMG_ENEMY0_BWIDTH 2
#define IMG_ENEMY0_HEIGHT 8
#define IMG_ENEMY0_SPRITES_CNT 4
//data size=64 bytes
const unsigned char img_enemy0_data[IMG_ENEMY0_SPRITES_CNT][IMG_ENEMY0_HEIGHT*IMG_ENEMY0_BWIDTH] PROGMEM={
{ 0, 0,     0, 0,     0, 0,     0, 0,     0, 0,      2, 160,     0, 0,     0, 0 },
{ 0, 0,     0, 0,     0, 0,     0, 0,     0, 0,      2, 160,     0, 0,     0, 0 },
{ 0, 0,     0, 0,     0, 0,     0, 0,     0, 0,     10, 128,     0, 0,     0, 0 },
{ 0, 0,     0, 0,     0, 0,     0, 0,     0, 0,     10, 128,     0, 0,     0, 0 }
};

//image generated from 2BITIMAGE - by Sandro Maffiodo
#define IMG_ENEMY2_MASK_WIDTH 8
#define IMG_ENEMY2_MASK_BWIDTH 2
#define IMG_ENEMY2_MASK_HEIGHT 8
#define IMG_ENEMY2_MASK_SPRITES_CNT 4
//data size=64 bytes
const unsigned char img_enemy2_mask_data[IMG_ENEMY2_MASK_SPRITES_CNT][IMG_ENEMY2_MASK_HEIGHT*IMG_ENEMY2_MASK_BWIDTH] PROGMEM={
{ 243,  63,     240, 15,     240, 15,     192, 3,      48, 12,      48, 12,     240, 15,     243, 207 },
{ 243,  63,     240, 15,     240, 15,     192, 3,     192,  3,     240, 15,     240, 15,     207, 243 },
{ 252, 207,     240, 15,     240, 15,     192, 3,      48, 12,      48, 12,     240, 15,     243, 207 },
{ 252, 207,     240, 15,     240, 15,     192, 3,     192,  3,     240, 15,     240, 15,     207, 243 }
};
//image generated from 2BITIMAGE - by Sandro Maffiodo
#define IMG_ENEMY2_WIDTH 8
#define IMG_ENEMY2_BWIDTH 2
#define IMG_ENEMY2_HEIGHT 8
#define IMG_ENEMY2_SPRITES_CNT 4
//data size=64 bytes
const unsigned char img_enemy2_data[IMG_ENEMY2_SPRITES_CNT][IMG_ENEMY2_HEIGHT*IMG_ENEMY2_BWIDTH] PROGMEM={
{ 0, 0,     0, 0,      2, 160,     0, 0,     0, 0,    192,  3,     0, 0,     0, 0 },
{ 0, 0,     0, 0,      2, 160,     0, 0,     0, 0,     12,  0,     0, 0,     0, 0 },
{ 0, 0,     0, 0,     10, 128,     0, 0,     0, 0,    192,  3,     0, 0,     0, 0 },
{ 0, 0,     0, 0,     10, 128,     0, 0,     0, 0,      0, 48,     0, 0,     0, 0 }
};

//image generated from 2BITIMAGE - by Sandro Maffiodo
#define IMG_ENEMY5_WIDTH 8
#define IMG_ENEMY5_BWIDTH 2
#define IMG_ENEMY5_HEIGHT 12
#define IMG_ENEMY5_SPRITES_CNT 4
//data size=96 bytes
const unsigned char img_enemy5_data[IMG_ENEMY5_SPRITES_CNT][IMG_ENEMY5_HEIGHT*IMG_ENEMY5_BWIDTH] PROGMEM={
{ 0, 0,    0, 0,    0, 0,     2, 168,     0, 0,     0, 0,     0, 0,    0, 0,      48,   3,     0, 0,     0, 0,     0, 0 },
{ 0, 0,    0, 0,    0, 0,     2, 168,     0, 0,     0, 0,     0, 0,    0, 0,      12,   0,     0, 0,     0, 0,     0, 0 },
{ 0, 0,    0, 0,    0, 0,    42, 128,     0, 0,     0, 0,     0, 0,    0, 0,     192,  12,     0, 0,     0, 0,     0, 0 },
{ 0, 0,    0, 0,    0, 0,    42, 128,     0, 0,     0, 0,     0, 0,    0, 0,       0,  48,     0, 0,     0, 0,     0, 0 },
};

//image generated from 2BITIMAGE - by Sandro Maffiodo
#define IMG_ENEMY5_MASK_WIDTH 8
#define IMG_ENEMY5_MASK_BWIDTH 2
#define IMG_ENEMY5_MASK_HEIGHT 12
#define IMG_ENEMY5_MASK_SPRITES_CNT 4
//data size=96 bytes
const unsigned char img_enemy5_mask_data[IMG_ENEMY5_MASK_SPRITES_CNT][IMG_ENEMY5_MASK_HEIGHT*IMG_ENEMY5_MASK_BWIDTH] PROGMEM={
{ 243,  63,    240,   3,    240,   3,    240,   3,    240,   3,    240,   3,     240,   3,    204,  12,     204,  12,     252,  15,     243, 243,      243, 243 },
{ 243,  63,    240,   3,    240,   3,    240,   3,    240,   3,    192,  15,     192,  15,    192,  63,     240,  63,     240,  15,     207, 243,       63, 243 },
{ 252, 207,    192,  15,    192,  15,    192,  15,    192,  15,    192,  15,     192,  15,     48,  51,      48,  51,     240,  63,     207, 207,      207, 207 },
{ 252, 207,    192,  15,    192,  15,    192,  15,    192,  15,    240,   3,     240,   3,    252,   3,     252,  15,     240,  15,     207, 243,      207, 252 }
};

//image generated from 2BITIMAGE - by Sandro Maffiodo
#define IMG_ENEMY6_WIDTH 16
#define IMG_ENEMY6_BWIDTH 4
#define IMG_ENEMY6_HEIGHT 16
#define IMG_ENEMY6_SPRITES_CNT 4
//data size=256 bytes
const unsigned char img_enemy6_data[IMG_ENEMY6_SPRITES_CNT][IMG_ENEMY6_HEIGHT*IMG_ENEMY6_BWIDTH] PROGMEM={
{  0, 0, 0, 0,     0, 0, 0, 0,     0, 0, 0, 0,     0,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 0, 0 },
{  0, 0, 0, 0,     0, 0, 0, 0,     0, 0, 0, 0,     0,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 0, 0 },
{  0, 0, 0, 0,     0, 0, 0, 0,     0, 0, 0, 0,     0,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 0, 0 },
{  0, 0, 0, 0,     0, 0, 0, 0,     0, 0, 0, 0,     0,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 0, 0 },
};

//image generated from 2BITIMAGE - by Sandro Maffiodo
#define IMG_ENEMY6_MASK_WIDTH 16
#define IMG_ENEMY6_MASK_BWIDTH 4
#define IMG_ENEMY6_MASK_HEIGHT 16
#define IMG_ENEMY6_MASK_SPRITES_CNT 4
//data size=256 bytes
const unsigned char img_enemy6_mask_data[IMG_ENEMY6_MASK_SPRITES_CNT][IMG_ENEMY6_MASK_HEIGHT*IMG_ENEMY6_MASK_BWIDTH] PROGMEM={
{ 255, 204, 255, 255,     255, 204, 255, 255,     255, 192,   3, 255,     255,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 243, 255 }, 
{ 255, 243,  63, 255,     255, 243,  63, 255,     255, 240,   0, 255,     255,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 252, 255 }, 
{ 255, 255,  51, 255,     255, 255,  51, 255,     255, 192,   3, 255,     255,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 252, 255 }, 
{ 255, 252, 207, 255,     255, 252, 207, 255,     255,   0,  15, 255,     255,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 255,  63 }, 
};

//font generated from BITFONZI - by Sandro Maffiodo
#define FNT_NANOFONT2_HEIGHT 6
#define FNT_NANOFONT2_SYMBOLS_COUNT 95
//data size=570 bytes
const unsigned char fnt_nanofont2_data[FNT_NANOFONT2_SYMBOLS_COUNT][1+FNT_NANOFONT2_HEIGHT] PROGMEM={
{ 1, 128, 128, 128,   0, 128,   0, }, //glyph '!' code=0
{ 3, 160, 160,   0,   0,   0,   0, }, //glyph '"' code=1
{ 3, 160, 224, 160, 224, 160,   0, }, //glyph '#' code=2
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{ 3,  32,  64, 224,  64, 224,   0, }, //glyph 'Â£' code=94
};
//image generated from 2BITIMAGE - by Sandro Maffiodo
#define IMG_SPLASH0_WIDTH 120
#define IMG_SPLASH0_BWIDTH 30
#define IMG_SPLASH0_HEIGHT 60
//data size=1800 bytes
const unsigned char img_splash0_data[IMG_SPLASH0_BWIDTH*IMG_SPLASH0_HEIGHT] PROGMEM={
  85,  85,  85,  85,  85,  85,  85,  64,   0,   0,   0,   0,   0,   0,   0,   0,   0,   0,   0,   0,   0,   0,   0,   0,   0,   0,  85,  85,  85,  85, 
  85,  85,  85,  85,  85,  85,  85,  64,   0,   0,   0,   0,   0,   0,   0,   0,   0,   0,   0,   0,   0,   0,   0,   0,   0,   0,  85,  85,  85,  85, 
  85,  85,  85,  85,  85,  85,  85,  64,   0,   0,   0,   0,   0,   0,   0,   0,   0,   0,   0,   0,   0,   0,   0,   0,   0,   0,  85,  85,  85,  85, 
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 170, 170, 170, 170, 170, 170,   0,   0,   0,   0,   0,   1,  85,  85,  85,  85,  85,  85,  85,  85,  85,  85,  85,  85,  85,  85,  85,  85,  85,  85, 
};
//image generated from 2BITIMAGE - by Sandro Maffiodo
#define IMG_SPLASH1A_WIDTH 62
#define IMG_SPLASH1A_BWIDTH 16
#define IMG_SPLASH1A_HEIGHT 57
//data size=912 bytes
const unsigned char img_splash1a_data[IMG_SPLASH1A_BWIDTH*IMG_SPLASH1A_HEIGHT] PROGMEM={
 85,  85,  85,  85,  85,  85,  85,  85,   0,   0,   5,  85,  85,  85,  85,  80, 
 85,  85,  85,  85,  85,  85,  85,  80, 255, 255, 240,  85,  85,  85,  85,  80, 
 85,  85,  85,  85,  85,  85,  85,  79, 255, 255, 255,  21,  85,  85,  85,  80, 
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 74, 162,  34,  42,   0,   0,  10, 170, 170, 170, 170, 170,   0,   0,  10, 128, 
};
//image generated from 2BITIMAGE - by Sandro Maffiodo
#define IMG_SPLASH1B_WIDTH 22
#define IMG_SPLASH1B_BWIDTH 6
#define IMG_SPLASH1B_HEIGHT 2
//data size=12 bytes
const unsigned char img_splash1b_data[IMG_SPLASH1B_BWIDTH*IMG_SPLASH1B_HEIGHT] PROGMEM={ //OFFSET: 27,17
240,   3, 207,  60,   0, 240, 
255, 255, 207,  63, 255, 240, 
};
//image generated from 2BITIMAGE - by Sandro Maffiodo
#define IMG_SPLASH1C_WIDTH 16
#define IMG_SPLASH1C_BWIDTH 4
#define IMG_SPLASH1C_HEIGHT 10
//data size=40 bytes
const unsigned char img_splash1c_data[IMG_SPLASH1C_BWIDTH*IMG_SPLASH1C_HEIGHT] PROGMEM={ //OFFSET: 29,30
  3, 255, 255, 192, 
  3, 192,   3, 192, 
 15,   0,   0, 240, 
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  0,   0,   0,   0, 
};
//image generated from 2BITIMAGE - by Sandro Maffiodo
#define IMG_SPLASH2A_WIDTH 55
#define IMG_SPLASH2A_BWIDTH 14
#define IMG_SPLASH2A_HEIGHT 49
//data size=686 bytes
const unsigned char img_splash2a_data[IMG_SPLASH2A_BWIDTH*IMG_SPLASH2A_HEIGHT] PROGMEM={
 85,  85,  85,  85,  85,  64,   0,   0,   5,  85,  85,  85,  85,  84, 
 85,  85,  85,  85,  84,   0,   0,   0,   0,  85,  85,  85,  85,  84, 
 85,  85,  85,  85,  80,   0,   0,   0,   0,  21,  85,  85,  85,  84, 
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 72, 136, 160,   0,   0,   0,   0,   0,   0,   0,   0,  40, 136, 132, 
};
//image generated from 2BITIMAGE - by Sandro Maffiodo
#define IMG_SPLASH2B_WIDTH 17
#define IMG_SPLASH2B_BWIDTH 5
#define IMG_SPLASH2B_HEIGHT 2
//data size=10 bytes
const unsigned char img_splash2b_data[IMG_SPLASH2B_BWIDTH*IMG_SPLASH2B_HEIGHT] PROGMEM={ //OFFSET: 19,18
 192,  63, 255,   0, 192, 
 255, 255, 255, 255, 192, 
};
//image generated from 2BITIMAGE - by Sandro Maffiodo
#define IMG_SPLASH2C_WIDTH 27
#define IMG_SPLASH2C_BWIDTH 7
#define IMG_SPLASH2C_HEIGHT 9
//data size=63 bytes
const unsigned char img_splash2c_data[IMG_SPLASH2C_BWIDTH*IMG_SPLASH2C_HEIGHT] PROGMEM={ //OFFSET: 15,22
  0,   0,   0,   0,   0,   0,   0, 
 64,   0,   0,   0,   0,   0,   4, 
 64,   0,   0,   0,   0,   0,   4, 
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 85,   0,   0,   0,   0,   1,  84, 
};
const unsigned char img_block_data[][4] PROGMEM={
{ 170, 187, 255, 255 },
{ 255, 255, 255, 255 },
{ 255, 125, 125, 85  }, //NEW TILE
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{ 85,  87,  95,  127 }, //NEW TILE
};
#define MAP_LINE_LENGTH 30
#define MAP_LINES 15
const char levels[][MAP_LINES][MAP_LINE_LENGTH+1] PROGMEM={ {
"    11                        ", //NEW LEVELS
"   115                        ",
"  111                       00",
" 7115         4 44  A      011",
"1111        4      00000000111",
"1111                         2",
"1111000000                    ",
"1111111111    A               ",
"     31111000000000       A   ",
"                 314     00000",
"                           111",
"                       00  311",
"                     0015   11",
" P      000000  0000 311    11",
"0000000011115   1111  11    31",
}, {
"                              ",
"     0 000        A           ",
"111111115        0000000      ",
"15                           0",
"5                         0001",
"                            31",
"    4   A              4      ",
"       000000   P             ",
" 4      3111100000       A    ",
"         15    111000   000000",
"         1                  31",
"4        1                   3",
"         10  000      0       ",
" B       11  3110     1   A   ",
"00000000011   3110  0010 00000",
}, {
"     112      2            2  ",
"     11                       ",
"     2                        ",
"                      B      0",
"          B          000000001",
"       4 00000000         3111",
"       2      3110 4        31",
"                3111         2",
"     4            21     A    ",
"    71      A      1   4 00000",
" 000110    000000001        31",
" 1111114         3110         ",
" 2115 11   P      11          ",
"  15  11 000000   110   A     ",
"  1   12 15  31   111 00000000",
}, {
"       2     21111112         ",
"              2   2           ",
"                         04   ",
"                         15   ",
" B                       1    ",
"00000000         C       1   4",
" 2 3111100000  00000000001   2",
"                  2112 211    ",
"                   11   314   ",
"      A            22     2   ",
"   0 0000000000               ",
"4             14             4",
"1             1              1",
"1 4         P 1           4 71",
"111 00000 00001000 4  4   1111",
}, {
"    111                        ",
"    1 2                       ",
"    2          A       A      ",
"6   1       0000000000 000000 ",
"1   1          2 3111   3111  ",
"1 71116  0          31116  11  ",
"1111111111            21111111",
"11111111110   P        215212 ",
"         2100000           2  ",
"               14             ",
"                              ",
"                   4    001111",
"                       0112  3",
"  D                 000112    ",
"000000000000000 4 4011111     ", //NEW2
} };

#define NOTE_B0 31
#define NOTE_C1 33
#define NOTE_CS1 35
#define NOTE_D1 37
#define NOTE_DS1 39
#define NOTE_E1 41
#define NOTE_F1 44
#define NOTE_FS1 46
#define NOTE_G1 49
#define NOTE_GS1 52
#define NOTE_A1 55
#define NOTE_AS1 58
#define NOTE_B1 62
#define NOTE_C2 65
#define NOTE_CS2 69
#define NOTE_D2 73
#define NOTE_DS2 78
#define NOTE_E2 82
#define NOTE_F2 87
#define NOTE_FS2 93
#define NOTE_G2 98
#define NOTE_GS2 104
#define NOTE_A2 110
#define NOTE_AS2 117
#define NOTE_B2 123
#define NOTE_C3 131
#define NOTE_CS3 139
#define NOTE_D3 147
#define NOTE_DS3 156
#define NOTE_E3 165
#define NOTE_F3 175
#define NOTE_FS3 185
#define NOTE_G3 196
#define NOTE_GS3 208
#define NOTE_A3 220
#define NOTE_AS3 233
#define NOTE_B3 247
#define NOTE_C4 262
#define NOTE_CS4 277
#define NOTE_D4 294
#define NOTE_DS4 311
#define NOTE_E4 330
#define NOTE_F4 349
#define NOTE_FS4 370
#define NOTE_G4 392
#define NOTE_GS4 415
#define NOTE_A4 440
#define NOTE_AS4 466
#define NOTE_B4 494
#define NOTE_C5 523
#define NOTE_CS5 554
#define NOTE_D5 587
#define NOTE_DS5 622
#define NOTE_E5 659
#define NOTE_F5 698
#define NOTE_FS5 740
#define NOTE_G5 784
#define NOTE_GS5 831
#define NOTE_A5 880
#define NOTE_AS5 932
#define NOTE_B5 988
#define NOTE_C6 1047
#define NOTE_CS6 1109
#define NOTE_D6 1175
#define NOTE_DS6 1245
#define NOTE_E6 1319
#define NOTE_F6 1397
#define NOTE_FS6 1480
#define NOTE_G6 1568
#define NOTE_GS6 1661
#define NOTE_A6 1760
#define NOTE_AS6 1865
#define NOTE_B6 1976
#define NOTE_C7 2093
#define NOTE_CS7 2217
#define NOTE_D7 2349
#define NOTE_DS7 2489
#define NOTE_E7 2637
#define NOTE_F7 2794
#define NOTE_FS7 2960
#define NOTE_G7 3136
#define NOTE_GS7 3322
#define NOTE_A7 3520
#define NOTE_AS7 3729
#define NOTE_B7 3951
#define NOTE_C8 4186
#define NOTE_CS8 4435
#define NOTE_D8 4699
#define NOTE_DS8 4978

#define KLEFT 1
#define KUP 2
#define KRIGHT 4
#define PMIRROR 16
#define PSTAND 32

#define EMIRROR (1 << 7)
#define EDEAD (1 << 6) //free space for 2 bits

#define SENDA -110 //NEW2
#define SENDB -111 //NEW2
#define SENDC -112 //NEW2
#define SGAMEOVER -128
#define SPRETITLE -127
#define STITLE -1
#define SINTROA -2
#define SINTROB -3
#define SINTROC -4
#define SINTROLAST -10
#define SLEVEL1 -100

static char px=0, py=48, prex, prey, pjump=1, scene=SPRETITLE;
static unsigned char pflags=PSTAND, plife=100, gflags=0;
static unsigned int lastm=0;
//11 bytes for player and global

#define MAXENEMIES 6
struct Enemy {
    char x, y;
    unsigned char eflags, cnttype;
};
static Enemy enemies[MAXENEMIES]; //4bytes for each enemy. 6*4=24bytes. Can be stripped down to 6*3 if enemies will NOT moves indipendently

#define SONG_SPEED 100
#define SONG_LENGTH(S) (sizeof S / sizeof(int))
static unsigned song_lastm=0; //4 bytes for songs
static char song=0, song_cnt=0;

static const int song_0[] PROGMEM={
    //----------------------------------
    //----------------------------------
    NOTE_A3, 0, 0, 0,
    0, 0, 0, 0,
    NOTE_A3, 0, NOTE_A3, 0,
    0, 0, 0, 0
};
#define SONG_0_LENGTH SONG_LENGTH(song_0)

static const int song_1[] PROGMEM={
    //-------------------------------------------------------
    NOTE_A3, 0, 0, 0,
    NOTE_F3, 0, NOTE_F4, 0,

    NOTE_A3, 0, 0, 0,
    NOTE_F3, 0, NOTE_F4, 0,

    NOTE_A3, 0, NOTE_A4, 0,
    NOTE_F3, 0, NOTE_F4, 0,

    NOTE_A3, NOTE_GS4, NOTE_F4, 0,
    NOTE_F3, NOTE_E4, NOTE_F4, 0,

    //-------------------------------------------------------
    NOTE_A3, 0, NOTE_A4, NOTE_A4,
    NOTE_F3, 0, NOTE_F4, 0,

    NOTE_A3, 0, NOTE_A4, NOTE_A4,
    NOTE_F3, 0, NOTE_F4, 0,

    NOTE_A3, 0, NOTE_A4, 0,
    NOTE_F3, 0, NOTE_F4, 0,

    NOTE_A3, NOTE_GS4, NOTE_F4, 0,
    NOTE_F3, NOTE_E4, NOTE_F4, 0,

    //-------------------------------------------------------
    //-------------------------------------------------------
    NOTE_A2, 0, NOTE_A3, 0,
    NOTE_F2, 0, NOTE_F3, 0,

    NOTE_A2, 0, NOTE_A3, 0,
    NOTE_F2, 0, NOTE_F3, 0,

    NOTE_A2, 0, NOTE_A3, 0,
    NOTE_F2, NOTE_F3, NOTE_F3, 0,

    NOTE_A2, NOTE_GS3, NOTE_F3, 0,
    NOTE_F2, NOTE_E3, NOTE_F3, 0,

    //-------------------------------------------------------
    NOTE_A2, 0, NOTE_A3, 0,
    NOTE_F2, 0, NOTE_F3, 0,

    NOTE_A2, 0, NOTE_A3, 0,
    NOTE_F2, 0, NOTE_F3, 0,

    NOTE_A2, 0, NOTE_A3, 0,
    NOTE_F2, NOTE_F3, NOTE_F3, 0,

    NOTE_A2, NOTE_GS3, NOTE_F3, 0,
    NOTE_F2, NOTE_E3, NOTE_F3, 0,

    //-------------------------------------------------------
    //-------------------------------------------------------
    NOTE_A3, 0, 0, 0,
    NOTE_F3, NOTE_F3, 0, 0,

    NOTE_A3, 0, 0, 0,
    NOTE_F3, NOTE_F3, 0, 0,

    NOTE_A3, 0, 0, 0,
    NOTE_F3, NOTE_F3, 0, 0,

    NOTE_A3, 0, 0, 0,
    0, 0, 0, 0,
};
#define SONG_1_LENGTH SONG_LENGTH(song_1)

static const int song_2[] PROGMEM={
    //----------------------------------
    //----------------------------------
    NOTE_A2, NOTE_F2, NOTE_A2, NOTE_F2,
    0, 0, 0, 0
};
#define SONG_2_LENGTH SONG_LENGTH(song_2)

static const int song_3[] PROGMEM={
    //----------------------------------
    //----------------------------------
    NOTE_A4, 0, NOTE_F4, NOTE_F4,
    0, 0, 0, 0
};
#define SONG_3_LENGTH SONG_LENGTH(song_3)

#define G_REPAINT 1
#define G_EMOVE 2
#define G_UPDATEINFO 4

#define tprint(str, x, y, color) \
    VGAX::printPROGMEM((byte*)fnt_nanofont2_data, \
                       FNT_NANOFONT2_SYMBOLS_COUNT, \
                       FNT_NANOFONT2_HEIGHT, \
                       0, 0, str, x, y, color)

#define tprint_SRAM(str, x, y, color) \
    VGAX::printSRAM((byte*)fnt_nanofont2_data, \
                    FNT_NANOFONT2_SYMBOLS_COUNT, \
                    FNT_NANOFONT2_HEIGHT, \
                    0, 0, str, x, y, color)

static inline void setsong(char s) {
    song=s;
    song_cnt=0;
}
static inline void setscene(char s, bool dontclear=false) {
    scene=s;
    VGAX::noTone();
    VGAX::delay(500);
    if (!dontclear)
        VGAX::clear(0x55);    
    switch (scene) {
    case SPRETITLE:
        tprint(PSTR("SANDRO MAFFIODO PRESENTS"), 16, 10+2, 1);
        tprint(PSTR("A TINY GAME FOR ARDUINO"), 18, 17+2, 2);
        tprint(PSTR("WRITEN WITH VGAX LIBRARY"), 15, 24+2, 2);
        tprint(PSTR("GRAPHICS, SOUNDS AND CODE BY"), 10, 31+2, 3);
        tprint(PSTR("SANDRO MAFFIODO"), 32, 38+2, 3);
        break;
    case STITLE:
        VGAX::blit((byte*)img_splash0_data, IMG_SPLASH0_WIDTH, IMG_SPLASH0_HEIGHT, 0, 0);
        break;
    case SINTROA:
    case SINTROLAST:
    case SENDA: //NEW2
        if (scene==SINTROLAST) 
            tprint(PSTR("OK SENSEI.\n\nI WILL DO IT\nAND COME\nBACK TO YOU"), 
                   IMG_SPLASH2A_WIDTH+14, 16, 2);
        else if (scene==SINTROA) //NEW2
            tprint(PSTR("HI SENSEI!\n\nI WANT TO\nBECOME A\nGREAT\nBIT NINJA!"), 
                   IMG_SPLASH2A_WIDTH+16, 13, 2);
        else  //NEW2
            tprint(PSTR("HI SENSEI!\n\nI'M BACK!\nI HAVE\nDESTROYED\nALL ROBOTS!"), 
                   IMG_SPLASH2A_WIDTH+16, 13, 2); //NEW2
        break;
    case SINTROB:
    case SINTROC:
     case SENDB: //NEW2
        if (scene==SINTROC) {
            VGAX::fillrect(0, 0, VGAX_WIDTH-IMG_SPLASH1A_WIDTH-2, VGAX_HEIGHT, 1);
        }
        if (scene==SINTROC)
            tprint(PSTR("TO BECOME\nBIT NINJA...\n\nYOU MUST\nDESTROY ALL\nTHE ROBOTS!"), 
                   10, 13, 2);
        else if (scene==SINTROB)  //NEW2
            tprint(PSTR("OK NINJA\n\nI WILL TEACH\nTO YOU THE\nSECRET OF\nBIT NINJA!"), 
                   10, 13, 2);
        else //NEW2
            tprint(PSTR("WELL DONE!\n\nNOW YOU\nHAVE BECOME\nTHE GREAT\nBIT NINJA!"), 
                   10, 13, 2); //NEW2
        break;
    case SGAMEOVER:
        tprint(PSTR("GAME OVER NINJA!"), 32, 27, 2);
        break;
    case SLEVEL1:
        tprint(PSTR("LEVEL 1"), 49, 27, 2); //TODO: aggiungere schermata LEVEL COMPLETED! con delay
        break;
    case SLEVEL1+1:
        tprint(PSTR("LEVEL 2"), 49, 27, 2);
        break;
    case SLEVEL1+2:
        tprint(PSTR("LEVEL 3"), 49, 27, 2); //NEW
        break;
    case SLEVEL1+3:
        tprint(PSTR("LEVEL 4"), 49, 27, 2); //NEW
        break;
    case SLEVEL1+4:
        tprint(PSTR("LEVEL 5"), 49, 27, 2); //NEW
        break;
    case SLEVEL1+5:
        tprint(PSTR("MISSION COMPLETED!"), 29, 27, 2); //NEW2
        break;
    case SENDC: //NEW2
        tprint(PSTR("THE END :-)"), 43, 27, 2); //NEW2
        break;
    }
    if (s==SENDA)
      setsong(1);
    else if (s==SGAMEOVER) 
        setsong(2);
    else if (s>=SLEVEL1 && s<=SLEVEL1+20) 
        setsong(3);
    pjump=1;
    pflags=0;
}
static inline void gameover() {
    setscene(SGAMEOVER);
    //lastm=millis();
}
static inline unsigned char enemy_height_from_type(unsigned char t) {
    return t==2 ? 12 : (t==3 ? 16 : 8);
}
static inline unsigned char enemy_height(struct Enemy &e) {
    return enemy_height_from_type(e.cnttype >> 5);
}
static inline int addenemy(char x, char y, unsigned char type) {
    for (unsigned char i=0; i!=MAXENEMIES; i++) {
        Enemy &e=enemies[i];
        if (e.eflags & EDEAD) {
            unsigned char randpos=(rand() % 15) & 0x0f;
            e.eflags=randpos;
            e.x=x+randpos;
            e.y=y;
            e.cnttype=(type << 5) | 0;
            e.y-=enemy_height_from_type(type)-4;
            return i;
        }
    }
    return -1;
}
static inline bool isblock(char c) {
    return c>='0' && c<='9';
}
static inline void loadlevel(unsigned char l) {
    //init enemies (all dead!)
    for (unsigned char i=0; i!=MAXENEMIES; i++) {
        Enemy &e=enemies[i];
        e.x=-1;
        e.y=-1;
        e.eflags=EDEAD;
        e.cnttype=0;
    }
    //load map
    for (unsigned char y=0; y!=MAP_LINES; y++) {
        for (unsigned char x=0; x!=MAP_LINE_LENGTH; x++) {
            char c=pgm_read_byte(&levels[l][y][x]);
            if (c>='A' && c<='D') {
                addenemy(x*4, y*4, c-'A'); 
            } else if (c=='P') {
                px=x*4;
                py=y*4-4;
            } else if (isblock(c)) {
                VGAX::blit4aligned((byte*)(&img_block_data[c-'0'][0]), 4, x, y*4);
            }
        }
    }
    gflags|=G_REPAINT;
}
static inline void drawe(struct Enemy &e) {
    unsigned char frame=e.eflags & EMIRROR ? 2 : 0;
    char ex=e.eflags & 0x0f;
    frame+=ex % 2;
    unsigned char type=e.cnttype >> 5;
    switch (type) {
    case 0:
        VGAX::blit8wmask((byte*)(img_enemy0_data[frame]), (byte*)(img_enemy0_mask_data[frame]), 8, e.x, e.y);
        break;
    case 1:
        VGAX::blit8wmask((byte*)(img_enemy2_data[frame]), (byte*)(img_enemy2_mask_data[frame]), 8, e.x, e.y);
        break;
    case 2:
        VGAX::blit8wmask((byte*)(img_enemy5_data[frame]), (byte*)(img_enemy5_mask_data[frame]), 12, e.x, e.y);
        break;
    case 3:
        VGAX::blitwmask((byte*)(img_enemy6_data[frame]), (byte*)(img_enemy6_mask_data[frame]), 16, 16, e.x, e.y);
        break;
    }
}
static inline void drawp() {
    unsigned char frame=pflags & PMIRROR ? 4 : 0;
    if (!(pflags & PSTAND)) 
        frame+=3;
    else if (pflags & (KLEFT|KRIGHT))
        frame+=VGAX::millis()%200>100 ? 2 : 1;
    VGAX::blit8wmask((byte*)(img_player_data[frame]), (byte*)(img_player_mask_data[frame]), 8, px, py);
}
static inline void refreshblock(char bx, char by) {
    if (bx<0 || by<0 || by>=VGAX_HEIGHT/4 || bx>=VGAX_WIDTH/4)
        return;
    char c=(char)pgm_read_byte(&levels[scene][by][bx]);
    if (isblock(c))
        VGAX::blit4aligned((byte*)(&img_block_data[c-'0'][0]), 4, bx, by*4);
}
static inline void clearp(char px, char py, unsigned char etype) {
    char bx=px/4;
    char by=py/4;
    if (etype==-1)
        VGAX::fillrect(px, py, 8, 6, 1);
    else
        VGAX::fillrect(px, py, etype==3 ? 16 : 8, etype>=2 ? 16 : 8, 1);
    #define refreshline() \
        refreshblock(bx, by); \
        refreshblock(bx+1, by); \
        refreshblock(bx+2, by);
    refreshline();
    by++;
    if (by<VGAX_HEIGHT/4) {
        refreshline();
        by++;
        if (by<VGAX_HEIGHT/4) {
            refreshline();
            by++;
            if (etype>=2) { //really needed ??????????? 
                if (by<VGAX_HEIGHT/4) {
                    refreshline();
                    by++;
                    if (by<VGAX_HEIGHT/4) {
                        refreshline();
                    }
                }
            }
        }
    }
}
#define BTN_UP 13
#define BTN_LEFT 12
#define BTN_RIGHT 11

static void getinput() {
    byte pre=pflags;
    if (digitalRead(BTN_UP)==LOW) {
        pflags|=KUP;
    } else {
        pflags&=~KUP;
    }
    if (digitalRead(BTN_LEFT)==LOW) {
        pflags|=KLEFT;
        pflags|=PMIRROR;
    } else {
        pflags&=~KLEFT;
    }
    if (digitalRead(BTN_RIGHT)==LOW) {
        pflags|=KRIGHT;
        pflags&=~PMIRROR;
    } else {
        pflags&=~KRIGHT;
    }
    if (pflags!=pre) {
        gflags|=G_REPAINT;
        if (0 && scene<0)
            VGAX::delay(500);
    }
}
static inline char get_block_slow(char x, char y) {
    if (y<0 || y>=VGAX_HEIGHT/4)
        return ' ';
    if (x<0 || x>=VGAX_WIDTH/4)
        return '1';
    return (char)pgm_read_byte(&levels[scene][y][x]);
}
static inline char zero_collision(char cx, char cy) {
    /*player size is 8x8. collision detection is for the lower center 4x4*/
    char c=get_block_slow((cx+2)/4, (cy+4)/4);
    if (isblock(c))
        return 0;
    c=get_block_slow((cx+5)/4, (cy+4)/4);
    if (isblock(c))
        return 0;
    c=get_block_slow((cx+2)/4, (cy+7)/4);
    if (isblock(c))
        return 0;
    c=get_block_slow((cx+5)/4, (cy+7)/4);
    if (isblock(c))
        return 0;
    return 1;
}
static inline bool rect_collision(char x1, char y1, char w1, char h1, char x2, char y2, char w2, char h2) {
    return x1 < x2 + w2 &&
           x1 + w1 > x2 &&
           y1 < y2 + h2 &&
           h1 + y1 > y2;
}
static inline char enemy_collision() {
    unsigned char ecnt=0;
    for (unsigned char i=0; i!=MAXENEMIES; i++) {
        Enemy &e=enemies[i];
        if (e.eflags & EDEAD)
            continue;
        ecnt++;
        unsigned char type=e.cnttype >> 5;

        if (rect_collision(px+2, py+2, 4, 6, e.x, e.y, type==3 ? 16 : 8, enemy_height_from_type(type))) {
            if (prey!=py && pjump>0) {
                pjump=-2; //NEW JUMP HEIGHT
                unsigned char cnt=e.cnttype & 0x1f;
                cnt++;
                playnote(220);
                VGAX::delay(100);
                playnote(0);
                if (cnt>4*(1+type)) {
                    e.eflags|=EDEAD;
                    ecnt--;
                    clearp(e.x, e.y, type);
                }
                e.cnttype=(type << 5) | cnt;
            } else {
                gflags|=G_UPDATEINFO;
                plife--;
                playnote(440);
                VGAX::delay(100);
                playnote(0);
                if (plife==0) {
                    gameover();
                    return 0;
                }
            }
            return -1;
        }
    }
    if (ecnt==0) {
        //level completed
        setscene(SLEVEL1+scene+1);
        return 1;
    }
    return -1;
}
static void gravity(bool rec) {
    char npy=py+pjump;
    if (pjump<2)
        pjump++;
    if (zero_collision(px, npy)) {
        pflags&=~PSTAND;
        gflags|=G_REPAINT;
        py=npy;
    } else {
        if (rec && pjump>0) { //was 1
            if (!(pflags & PSTAND)) {
                pflags|=PSTAND;
                gflags|=G_REPAINT;
                pjump=1;
                gravity(0);
            }
        }
    }
}
static inline void playnote(int freq) {
    if (!freq)
        VGAX::noTone();
    else
        VGAX::tone(freq);
}
#define RUN_SLOW 0

static inline void rsetup() {
    pinMode(BTN_UP, INPUT_PULLUP);
    pinMode(BTN_LEFT, INPUT_PULLUP);
    pinMode(BTN_RIGHT, INPUT_PULLUP);
    VGAX::begin();
    VGAX::clear(0);
    setscene(SPRETITLE, true);
}
static inline void small_itoa(char num, char *str) {
    char i=1;
    if (num==0) {
        str[0]='0';
        str[1]=0;
        return;
    }
    if (num>99)
      i=3;
    else if (num>9)
      i=2;
    str[i--]=0;
    while (num!=0) {
        char rem=num % 10;
        str[i--]=rem+'0';
        num=num/10;
    }
}

static inline void rloop() {
    unsigned char tmp;
    getinput();
    prex=px;
    prey=py;
    //apply gravity to player and check collisions
    gravity(1);
    //check input
    if (pflags & KLEFT) {
        if (zero_collision(px-1, py)) {
            gflags|=G_REPAINT;
            px--;
        }
    }
    if (pflags & KRIGHT) {
        if (zero_collision(px+1, py)) {
            gflags|=G_REPAINT;
            px++;
        }
    }
    if (pflags & KUP) {
        if (pflags & PSTAND) {
            pjump=-5;
            pflags&=~PSTAND;
        }
    }
    //check events
    if (py>=VGAX_HEIGHT) {
        gameover();
        return;
    }
    tmp=enemy_collision();
    if (tmp==0) {
        gameover();
        return;
    } else if (tmp==1) {
        return;
    }
    gflags|=(VGAX::millis()-lastm>200) ? G_EMOVE : 0;

    if (gflags) {
        if (px<=12 && py<=10) { //NEW
            gflags|=G_UPDATEINFO; //NEW
        } //NEW
        if (gflags & G_UPDATEINFO) {
            VGAX::fillrect(1, 1, 12, 5, 1); //NEW, CHANGED WIDTH
        }
        clearp(prex, prey, -1);

        if (gflags & G_EMOVE) {
            lastm=VGAX::millis();
        }
        for (unsigned char i=0; i!=MAXENEMIES; i++) {
            Enemy &e=enemies[i];
            if (e.eflags & EDEAD)
                continue;
            unsigned char type=e.cnttype >> 5;
            clearp(e.x, e.y, type);
        }
        for (unsigned char i=0; i!=MAXENEMIES; i++) {
            Enemy &e=enemies[i];
            if (e.eflags & EDEAD)
                continue;
            if (gflags & G_EMOVE) {
                unsigned char ex=e.eflags & 0x0f;
                ex+=e.eflags & EMIRROR ? -1 : 1;
                e.x+=e.eflags & EMIRROR ? -1 : 1;
                if (ex==15 || ex==0) {
                    if (e.eflags & EMIRROR) {
                        e.eflags&=~EMIRROR;
                    } else {
                        e.eflags|=EMIRROR;
                    }
                }
                e.eflags=(e.eflags & 0xf0)|ex;
            }
            drawe(e);
        }
        if (gflags & G_UPDATEINFO) {
            char tmp[4]={ 0, 0, 0, 0 };
            small_itoa(plife, tmp);
            tprint_SRAM(tmp, 1, 1, 2);
        }
        drawp();
    }
    gflags=0;
    //VGAX::delay(5000);
    VGAX::delay(RUN_SLOW ? 500 : 40);
}
int main() {
  init();
  rsetup();
  while (1)
    rloop();
  return 0;
}